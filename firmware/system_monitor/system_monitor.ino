/********************************************************
 * Pugliese Hardware — System Monitor
 * ATmega328PB + OLED SSD1306 128x64 I2C
 * Logo → slider CPU/GPU/RAM/DISK ogni 6s
 * Display OFF se il PC si disconnette
 *
 * Progetto: Pugliese Hardware (pugliese-hardware.it)
 * Firmware 100% autocontenuto
 ********************************************************/
#include <Wire.h>
#include <Adafruit_GFX.h>
#include <Adafruit_SSD1306.h>

#define W 128
#define H 64
Adafruit_SSD1306 d(W, H, &Wire, -1);

#define N 4
const char* TXT[N] = {"CPU","GPU","RAM","DISK"};
float cur[N] = {0}, tgt[N] = {0};
unsigned long lastRx = 0;
int slide = 0;
bool asleep = true;

// ── Logo 128x64 (bianco su nero) ─────────────────────
static const unsigned char PROGMEM LOGO[] = {
  0x00,0x00,0x00,0x00,0x00,0x01,0x80,0x00,0x00,0x00,0x00,0x00,0x00,0x00,0x00,0x00,
  0x00,0x00,0x00,0x00,0x00,0x07,0xC0,0x00,0x00,0x00,0x00,0x00,0x00,0x00,0x00,0x00,
  0x00,0x00,0x00,0x00,0x00,0x0F,0x80,0x00,0x00,0x00,0x00,0x00,0x00,0x00,0x00,0x00,
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  0x00,0x00,0x00,0x00,0x00,0x1E,0x00,0x00,0x00,0x00,0x00,0x00,0x00,0x00,0x00,0x00
};

// ── Setup ────────────────────────────────────────────
void setup() {
  Serial.begin(115200);
  if (!d.begin(SSD1306_SWITCHCAPVCC,0x3C)) { while(1){} }
  d.clearDisplay();
  d.setTextColor(SSD1306_WHITE);
  d.drawBitmap(0,0,LOGO,128,64,SSD1306_WHITE);
  d.display();
  delay(2500);
  d.clearDisplay();
  d.display();
}

// ── Loop ─────────────────────────────────────────────
void loop() {
  while (Serial.available()) {
    String s = Serial.readStringUntil('\n');
    s.trim();
    if (s.length()) {
      int pos = 0;
      for (int i=0; i<N; i++) {
        int c = s.indexOf(':',pos);
        if (c<0) break;
        int p = s.indexOf('|',c);
        if (p<0) p = s.length();
        tgt[i] = constrain(s.substring(c+1,p).toFloat(),0.0f,100.0f);
        pos = p+1;
      }
      lastRx = millis();
    }
  }

  bool conn = (millis()-lastRx) < 3000;

  if (conn) {
    if (asleep) {
      d.ssd1306_command(0xAF);
      asleep = false;
    }

    static unsigned long lastA = 0;
    float dt = (millis()-lastA)/16.667f;
    lastA = millis();
    for (int i=0; i<N; i++) {
      float d = tgt[i]-cur[i];
      if (d<0.3f && d>-0.3f) cur[i]=tgt[i];
      else cur[i] += d*0.06f*dt;
      if (cur[i]<0) cur[i]=0;
      if (cur[i]>100) cur[i]=100;
    }

    static unsigned long lastS = 0;
    if (millis()-lastS > 6000) {
      slide = (slide+1)%N;
      lastS = millis();
    }

    d.clearDisplay();

    // Angolari cyberpunk
    const uint8_t c = 14;
    d.drawFastHLine(0, 0, c, SSD1306_WHITE);
    d.drawFastVLine(0, 0, c, SSD1306_WHITE);
    d.drawFastHLine(W - c, 0, c, SSD1306_WHITE);
    d.drawFastVLine(W - 1, 0, c, SSD1306_WHITE);
    d.drawFastHLine(0, H - 1, c, SSD1306_WHITE);
    d.drawFastVLine(0, H - c - 1, c, SSD1306_WHITE);
    d.drawFastHLine(W - c, H - 1, c, SSD1306_WHITE);
    d.drawFastVLine(W - 1, H - c - 1, c, SSD1306_WHITE);

    // Nome (size 3, centrato sopra)
    d.setTextColor(SSD1306_WHITE);
    d.setTextSize(3);
    d.setCursor((W - (int)strlen(TXT[slide]) * 18) / 2, 6);
    d.print(TXT[slide]);

    // Percentuale (size 3, centrata sotto)
    char buf[8];
    sprintf(buf, "%d%%", (int)cur[slide]);
    d.setCursor((W - (int)strlen(buf) * 18) / 2, 34);
    d.print(buf);
    d.setTextSize(1);
    d.display();
  } else {
    if (!asleep) {
      d.clearDisplay();
      d.display();
      d.ssd1306_command(0xAE);
      asleep = true;
    }
  }

  delay(20);
}
